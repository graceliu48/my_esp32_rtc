#include "lcd_display.h"
#include "rtc_config.h"
#include <math.h>

static const uint8_t font5x7[] = {
  0x00,0x00,0x00,0x00,0x00, // SPACE
  0x00,0x00,0x5F,0x00,0x00, // !
  0x00,0x07,0x00,0x07,0x00, // "
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  0x08,0x1C,0x2A,0x08,0x08  // DEL
};

LCDDisplay::LCDDisplay()
  : _cs(LCD_CS), _dc(LCD_DC), _rst(LCD_RST), _bl(LCD_BL),
    _initialized(false), _isOn(false), _brightness(100) {
}

void LCDDisplay::begin() {
  pinMode(_cs, OUTPUT);
  pinMode(_dc, OUTPUT);
  pinMode(_rst, OUTPUT);
  pinMode(_bl, OUTPUT);
  digitalWrite(_bl, LOW);

  digitalWrite(_cs, HIGH);
  digitalWrite(_rst, LOW);
  delay(10);
  digitalWrite(_rst, HIGH);
  delay(120);

  _spi.begin(LCD_SCLK, -1, LCD_MOSI, -1);
  _spi.setFrequency(20000000);
  _spi.setDataMode(SPI_MODE0);

  initST7735();

  ledcSetup(0, 5000, 8);
  ledcAttachPin(_bl, 0);
  ledcWrite(0, 0);

  _initialized = true;
  _isOn = false;
}

void LCDDisplay::initST7735() {
  static const uint8_t init_cmds[] = {
    0x01, 0x80, 150,              // SWRESET
    0x11, 0x80, 255,              // SLPOUT
    0xB1, 0x03, 0x01, 0x2C, 0x2D,// FRMCTR1
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    0x29, 0x80, 10,               // DISPON
    0x00
  };

  uint8_t idx = 0;
  while (init_cmds[idx] != 0x00) {
    uint8_t cmd = init_cmds[idx++];
    uint8_t len = init_cmds[idx++];
    uint8_t delay_ms = (len & 0x80) ? init_cmds[idx++] : 0;
    len &= 0x7F;
    writeCmd(cmd);
    for (uint8_t i = 0; i < len; i++) {
      writeData(init_cmds[idx++]);
    }
    if (delay_ms) delay(delay_ms);
  }
}

void LCDDisplay::writeCmd(uint8_t cmd) {
  digitalWrite(_dc, LOW);
  digitalWrite(_cs, LOW);
  _spi.write(cmd);
  digitalWrite(_cs, HIGH);
}

void LCDDisplay::writeData(uint8_t data) {
  digitalWrite(_dc, HIGH);
  digitalWrite(_cs, LOW);
  _spi.write(data);
  digitalWrite(_cs, HIGH);
}

void LCDDisplay::writeData16(uint16_t data) {
  digitalWrite(_dc, HIGH);
  digitalWrite(_cs, LOW);
  _spi.write16(data);
  digitalWrite(_cs, HIGH);
}

void LCDDisplay::writeBuf(uint8_t *buf, uint32_t len) {
  digitalWrite(_dc, HIGH);
  digitalWrite(_cs, LOW);
  _spi.writeBytes(buf, len);
  digitalWrite(_cs, HIGH);
}

void LCDDisplay::setAddrWindow(uint16_t x0, uint16_t y0,
                                uint16_t x1, uint16_t y1) {
  writeCmd(0x2A);
  writeData16(x0 + 1);
  writeData16(x1 + 1);
  writeCmd(0x2B);
  writeData16(y0 + 26);
  writeData16(y1 + 26);
  writeCmd(0x2C);
}

void LCDDisplay::fillRect(int16_t x, int16_t y, int16_t w, int16_t h,
                           uint16_t color) {
  if (x < 0) { w += x; x = 0; }
  if (y < 0) { h += y; y = 0; }
  if (x + w > LCD_WIDTH)  w = LCD_WIDTH - x;
  if (y + h > LCD_HEIGHT) h = LCD_HEIGHT - y;
  if (w <= 0 || h <= 0) return;

  setAddrWindow(x, y, x + w - 1, y + h - 1);
  uint32_t pixels = w * h;
  uint8_t hi = color >> 8, lo = color & 0xFF;

  digitalWrite(_dc, HIGH);
  digitalWrite(_cs, LOW);

  uint8_t buf[64];
  for (uint32_t i = 0; i < 64; i += 2) {
    buf[i] = hi;
    buf[i + 1] = lo;
  }
  while (pixels > 32) {
    _spi.writeBytes(buf, 64);
    pixels -= 32;
  }
  _spi.writeBytes(buf, pixels * 2);

  digitalWrite(_cs, HIGH);
}

void LCDDisplay::clear(uint16_t color) {
  fillRect(0, 0, LCD_WIDTH, LCD_HEIGHT, color);
  _lastDate = _lastTime = _lastWeekday = _lastStatus = "";
}

void LCDDisplay::drawMonochromeBitmap(int16_t x, int16_t y, int16_t w, int16_t h, const uint8_t *data, uint16_t color) {
  setAddrWindow(x, y, x + w - 1, y + h - 1);
  digitalWrite(_dc, HIGH);
  digitalWrite(_cs, LOW);
  int16_t bpr = (w + 7) / 8;
  for (int16_t row = 0; row < h; row++) {
    for (int16_t col = 0; col < w; col++) {
      _spi.write16(data[row * bpr + col / 8] & (0x80 >> (col % 8)) ? color : COLOR_BLACK);
    }
  }
  digitalWrite(_cs, HIGH);
}

void LCDDisplay::fillCircle(int16_t cx, int16_t cy, int16_t r, uint16_t color) {
  for (int16_t y = -r; y <= r; y++) {
    int16_t w = sqrt(r * r - y * y);
    fillRect(cx - w, cy + y, w * 2 + 1, 1, color);
  }
}

void LCDDisplay::drawWifiLED(bool connected, bool visible) {
  if (!_initialized) return;
  int16_t cx = LCD_WIDTH - 10, cy = 7, r = 4;
  if (connected) {
    fillCircle(cx, cy, r, COLOR_GREEN);
  } else if (visible) {
    fillCircle(cx, cy, r, COLOR_RED);
  } else {
    fillCircle(cx, cy, r, COLOR_BLACK);
  }
}

void LCDDisplay::drawChar(int16_t x, int16_t y, char c,
                           uint16_t color, uint8_t size) {
  if (c < 0x20 || c > 0x7E) c = ' ';
  c -= 0x20;

  int16_t w = 5 * size, h = 7 * size;
  setAddrWindow(x, y, x + w - 1, y + h - 1);
  digitalWrite(_dc, HIGH);
  digitalWrite(_cs, LOW);

  for (int8_t row = 0; row < 7; row++) {
    for (uint8_t sy = 0; sy < size; sy++) {
      for (int8_t col = 0; col < 5; col++) {
        bool on = font5x7[c * 5 + col] & (1 << row);
        uint16_t pix = on ? color : COLOR_BLACK;
        for (uint8_t sx = 0; sx < size; sx++) {
          _spi.write16(pix);
        }
      }
    }
  }
  digitalWrite(_cs, HIGH);
}

void LCDDisplay::drawString(int16_t x, int16_t y, const String &str,
                             uint16_t color, uint8_t size) {
  int16_t cx = x;
  for (uint16_t i = 0; i < str.length(); i++) {
    if (cx + 5 * size > LCD_WIDTH) break;
    drawChar(cx, y, str[i], color, size);
    cx += 6 * size;
  }
}

int16_t LCDDisplay::drawCentered(int16_t y, const String &str,
                                  uint16_t color, uint8_t size) {
  int16_t w = str.length() * 6 * size;
  int16_t x = (LCD_WIDTH - w) / 2;
  if (x < 0) x = 0;
  drawString(x, y, str, color, size);
  return x;
}

void LCDDisplay::showSplash(const String &line1, const String &line2) {
  clear();
  drawCentered(20, line1, COLOR_WHITE, 2);
  drawCentered(50, line2, COLOR_WHITE, 1);
}

void LCDDisplay::setBrightness(uint8_t level) {
  _brightness = constrain(level, 0, 100);
  if (_initialized && _isOn) {
    ledcWrite(0, map(_brightness, 0, 100, 0, 255));
  }
}

void LCDDisplay::updateTime(const String &dateStr, const String &timeStr,
                             const String &weekdayStr, const String &statusStr) {
  if (!_initialized) return;

  if (dateStr != _lastDate || weekdayStr != _lastWeekday) {
    fillRect(0, 0, LCD_WIDTH, 14, COLOR_BLACK);
    int16_t totalW = dateStr.length() * 6 + 4 + weekdayStr.length() * 6;
    int16_t x0 = (LCD_WIDTH - totalW) / 2;
    drawString(x0, 2, dateStr, COLOR_CYAN, 1);
    drawString(x0 + dateStr.length() * 6 + 4, 2, weekdayStr, COLOR_YELLOW, 1);
    _lastDate = dateStr;
    _lastWeekday = weekdayStr;
  }
  if (timeStr != _lastTime) {
    fillRect(0, 15, LCD_WIDTH, 36, COLOR_BLACK);
    drawCentered(19, timeStr, COLOR_GREEN, 3);
    _lastTime = timeStr;
  }
  if (statusStr != _lastStatus) {
    fillRect(0, 52, LCD_WIDTH, 10, COLOR_BLACK);
    drawCentered(53, statusStr, COLOR_GRAY, 1);
    _lastStatus = statusStr;
  }
}

void LCDDisplay::on() {
  _isOn = true;
  writeCmd(0x29);
  ledcWrite(0, map(_brightness, 0, 100, 0, 255));
}

void LCDDisplay::off() {
  _isOn = false;
  writeCmd(0x28);
  ledcWrite(0, 0);
}
